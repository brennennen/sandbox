## embedded/build_systems/yocto/simple_arm_yocto/conf/local.conf
```bitbake
#MACHINE ?= "qemuarm64"
MACHINE = "qemuarm64"

# Store intermediate files out of tree in a well known location that has a lot of disk space.
DL_DIR ?= "/mnt/d_wsl/yocto/downloads"
SSTATE_DIR ?= "/mnt/d_wsl/yocto/sstate"
TMPDIR ?= "/mnt/d_wsl/yocto/tmp"

# DISTRO ?= "poky"
# PACKAGE_CLASSES ?= "package_rpm"

# "debug-tweaks" sets up root access with a blank password
# EXTRA_IMAGE_FEATURES ?= "debug-tweaks"

# Collect build statistics
USER_CLASSES ?= "buildstats"

# Disk Space Monitoring
BB_DISKMON_DIRS ??= "\
    STOPTASKS,${TMPDIR},1G,100K \
    STOPTASKS,${DL_DIR},1G,100K \
    STOPTASKS,${SSTATE_DIR},1G,100K \
    STOPTASKS,/tmp,100M,100K \
    HALT,${TMPDIR},100M,1K \
    HALT,${DL_DIR},100M,1K \
    HALT,${SSTATE_DIR},100M,1K \
    HALT,/tmp,10M,1K"

# TODO: explore runtime testing of images
#IMAGE_CLASSES += "testimage testsdk"
#TESTIMAGE_AUTO:qemuall = "1"

# Disable interactive patch resolution.
PATCHRESOLVE = "noop"

# TODO: explore shared-state files from other locations
#SSTATE_MIRRORS ?= "\
#file://.* https://someserver.tld/share/sstate/PATH;downloadfilename=PATH \
#file://.* file:///some/local/dir/sstate/PATH"

# TODO: explore Yocto Project SState Mirror and hash equivalence
#BB_HASHSERVE_UPSTREAM = 'wss://hashserv.yoctoproject.org/ws'
#SSTATE_MIRRORS ?= "file://.* http://cdn.jsdelivr.net/yocto/sstate/all/PATH;downloadfilename=PATH"
#BB_HASHSERVE = "auto"
#BB_SIGNATURE_HANDLER = "OEEquivHash"

# Memory Resident Bitbake
BB_SERVER_TIMEOUT = "60"

# Qemu configuration
PACKAGECONFIG:append:pn-qemu-system-native = " sdl"

CONF_VERSION = "2"
```

## embedded/build_systems/yocto/simple_arm_yocto/meta-hello/conf/layer.conf
```bitbake
# https://docs.yoctoproject.org/dev/dev-manual/layers.html
# We have a conf and classes directory, add to BBPATH
BBPATH .= ":${LAYERDIR}"

# We have recipes-* directories, add to BBFILES
BBFILES += "${LAYERDIR}/recipes-*/*/*.bb \
            ${LAYERDIR}/recipes-*/*/*.bbappend"

BBFILE_COLLECTIONS += "hello"
BBFILE_PATTERN_hello = "^${LAYERDIR}/"
BBFILE_PRIORITY_hello = "5"
LAYERVERSION_hello = "4"
LAYERSERIES_COMPAT_hello = "styhead"

DL_DIR = "/mnt/d_wsl/yocto/downloads"
SSTATE_DIR = "/mnt/d_wsl/yocto/sstate"
```

## embedded/devboards/stm/stm32mp157/mp157_sandbox/conf/local.conf
```bitbake
MACHINE ?= "stm32mp1"

# Collect build statistics
USER_CLASSES ?= "buildstats"

# Disk Space Monitoring
BB_DISKMON_DIRS ??= "\
    STOPTASKS,${TMPDIR},1G,100K \
    STOPTASKS,${DL_DIR},1G,100K \
    STOPTASKS,${SSTATE_DIR},1G,100K \
    STOPTASKS,/tmp,100M,100K \
    HALT,${TMPDIR},100M,1K \
    HALT,${DL_DIR},100M,1K \
    HALT,${SSTATE_DIR},100M,1K \
    HALT,/tmp,10M,1K"

# Disable interactive patch resolution.
PATCHRESOLVE = "noop"

# Memory Resident Bitbake
BB_SERVER_TIMEOUT = "60"

# Build linux kernel headers into "populate_sdk" for linux driver development
TOOLCHAIN_TARGET_TASK += "kernel-devsrc"

# Qemu configuration
PACKAGECONFIG:append:pn-qemu-system-native = " sdl"

CONF_VERSION = "2"
```

## embedded/devboards/stm/stm32mp157/mp157_sandbox/meta-mp157sandbox/conf/layer.conf
```bitbake
# https://docs.yoctoproject.org/dev/dev-manual/layers.html
# We have a conf and classes directory, add to BBPATH
BBPATH .= ":${LAYERDIR}"

# We have recipes-* directories, add to BBFILES
BBFILES += "${LAYERDIR}/recipes-*/*/*.bb \
            ${LAYERDIR}/recipes-*/*/*.bbappend"

BBFILE_COLLECTIONS += "mp157sandbox"
BBFILE_PATTERN_mp157sandbox = "^${LAYERDIR}/"
BBFILE_PRIORITY_mp157sandbox = "5"
LAYERVERSION_mp157sandbox = "4"
LAYERSERIES_COMPAT_mp157sandbox = "styhead"
```
